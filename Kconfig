## Kconfig
```kconfig
# Copyright (c) 2024 Justin's Engineering Services LLC
# SPDX-License-Identifier: Apache-2.0

rsource "drivers/multiplexer/Kconfig"
```

## drivers/multiplexer/Kconfig
```kconfig
# Top-level configuration file for multiplexer drivers.

# Copyright (c) 2024 Justin's Engineering Services LLC
# SPDX-License-Identifier: Apache-2.0

menuconfig MULTIPLEXER
	bool "Multiplexer drivers"
  depends on GPIO
	help
	  Include multiplexer drivers in the system configuration.

if MULTIPLEXER

config MULTIPLEXER_INIT_PRIORITY
	int "Multiplexor initialization priority"
	default 90
	help
	  System initialization priority for multiplexer drivers.

endif # MULTIPLEXER
```

## dts/bindings/multiplexer.yml
```yaml
# Copyright (c) 2024 Justin's Engineering Services LLC
# SPDX-License-Identifier: Apache-2.0

description: |
  Generic multiplexer bindings
compatible: "multiplexer"

include: [base.yaml]

properties:
  gpios:
    type: phandle-array
    required: true
    description: |
      GPIO phandles for the multiplexer select pins in ascending order.
```
